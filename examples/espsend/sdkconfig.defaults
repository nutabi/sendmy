## examples/espsend/sdkconfig.defaults
```kconfig
# ----------------------------------------------------------------------------
# Target and build settings
# ----------------------------------------------------------------------------

# Target board
CONFIG_IDF_TARGET="esp32s3"

# Reproducible build (easier to profile)
CONFIG_APP_REPRODUCIBLE_BUILD=y

# Flash size
CONFIG_ESPTOOLPY_FLASHSIZE_8MB=y
CONFIG_PARTITION_TABLE_SINGLE_APP_LARGE=y

# ----------------------------------------------------------------------------
# BLE settings
# ----------------------------------------------------------------------------

# Host stack - NimBLE
CONFIG_BT_ENABLED=y
CONFIG_BT_NIMBLE_ENABLED=y

# ----------------------------------------------------------------------------
# Logging
# ----------------------------------------------------------------------------

# Default for all logging tags (including system ones, excluding bootloader)
#CONFIG_LOG_DEFAULT_LEVAL_WARN=y
#CONFIG_LOG_MAXIMUM_LEVEL_VERBOSE=y

# Default for bootloader
#CONFIG_BOOTLOADER_LOG_LEVEL_WARN=y
```

## examples/esptag/main/Kconfig.projbuild
```kconfig
menu "esptag configuration"

choice ESPTAG_OWN_LOG_LEVEL_CHOICE
    prompt "Log level for esptag's own modules"
    default ESPTAG_OWN_LOG_LEVEL_INFO
    help
        Runtime log level applied at startup to this project's own log tags
        (main, crypto, nvs_store, tag, ble_adv). The system-wide default stays
        at WARN (see CONFIG_LOG_DEFAULT_LEVEL), keeping the IDF / NimBLE /
        controller components quiet; this only adjusts our own modules.

        Levels above WARN require CONFIG_LOG_MAXIMUM_LEVEL to be high enough
        for the calls to be compiled in (this project compiles VERBOSE in).

    config ESPTAG_OWN_LOG_LEVEL_NONE
        bool "No output"
    config ESPTAG_OWN_LOG_LEVEL_ERROR
        bool "Error"
    config ESPTAG_OWN_LOG_LEVEL_WARN
        bool "Warning"
    config ESPTAG_OWN_LOG_LEVEL_INFO
        bool "Info"
    config ESPTAG_OWN_LOG_LEVEL_DEBUG
        bool "Debug"
    config ESPTAG_OWN_LOG_LEVEL_VERBOSE
        bool "Verbose"
endchoice

config ESPTAG_OWN_LOG_LEVEL
    int
    # Values match the esp_log_level_t enum (NONE=0 .. VERBOSE=5).
    default 0 if ESPTAG_OWN_LOG_LEVEL_NONE
    default 1 if ESPTAG_OWN_LOG_LEVEL_ERROR
    default 2 if ESPTAG_OWN_LOG_LEVEL_WARN
    default 3 if ESPTAG_OWN_LOG_LEVEL_INFO
    default 4 if ESPTAG_OWN_LOG_LEVEL_DEBUG
    default 5 if ESPTAG_OWN_LOG_LEVEL_VERBOSE

config ESPTAG_ROTATE_ENABLE
    bool "Rotate the advertising key/identifier"
    default y
    help
        Periodically advance an epoch: ratchet the symmetric key, derive a fresh
        advertising identifier, and re-advertise under it (every
        CONFIG_ESPTAG_ROTATE_INTERVAL_MS). This is the privacy core of the
        design — rotating identities is what stops a passive observer from
        linking sightings over time.

        Disable only for debugging or characterisation where you want the tag to
        keep advertising under a single, static identity: the rotation timer is
        never armed, so it stays at the boot epoch indefinitely.

config ESPTAG_ROTATE_INTERVAL_MS
    int "Key/identifier rotation interval (ms)"
    default 900000
    range 1000 86400000
    help
        How often the tag advances an epoch: ratchets the symmetric key, derives
        a fresh advertising identifier, and re-advertises under it. The default
        of 900000 ms (15 min) matches the Find My cadence; lower it to a few
        seconds to watch rotation happen while testing.

config ESPTAG_ADV_INTERVAL_MS
    int "BLE advertising interval (ms)"
    default 2000
    range 20 10240
    help
        How often a BLE legacy advertising event fires. One advertising event
        sweeps all three primary channels (37/38/39) exactly once, so this is
        effectively "one broadcast per channel per window". itvl_min and
        itvl_max are both pinned to this value (see ble_adv.c), giving a fixed
        interval with no min/max jitter; the controller still adds the
        spec-mandated 0-10 ms advDelay on top.

        The range matches the BLE legacy non-connectable advertising limits
        (20 ms .. 10240 ms).

config ESPTAG_PERSIST_COUNTER
    bool "Persist rotation counter across reboots"
    default y
    help
        Persist the rotation counter to a writable NVS namespace and, at boot,
        fast-forward the symmetric-key ratchet to that epoch (crypto_advance_sk).
        This stops the tag from replaying the same identifier sequence
        (p_0, p_1, ...) after every power cycle — a linkability regression for a
        privacy design.

        When set, the counter is read at startup and written after each epoch
        advance. When unset, the tag always boots at counter 0 and never writes
        the counter — an ephemeral mode for testing (rapid rotation with no flash
        wear and reproducible from-zero behavior).

config ESPTAG_ZEROIZE
    bool "Scrub intermediate key material (zeroize)"
    default y
    help
        Scrub all intermediate key material (scalars, SK ratchet state) with
        mbedtls_platform_zeroize on every path, including error paths. When set,
        CONFIG_ESPTAG_ZEROIZE gates those #ifdef guards in the sources directly.

        Leave enabled for any real build; only disable for local debugging where
        you want to inspect that material left on the stack.

endmenu
```

## examples/esptag/sdkconfig.defaults
```kconfig
# sdkconfig.defaults — esptag (Find My-style BLE locator tag)
#
# Regenerate sdkconfig from this file:   rm sdkconfig && idf.py reconfigure
#
# This project is a NON-CONNECTABLE BLE BEACON: it only broadcasts rotating
# advertising identifiers. It never connects, pairs, scans, or serves GATT, so
# the entire connection/GATT/security half of the BLE stack is disabled below.

# ── Target / board: Seeed Studio XIAO ESP32-S3 (ESP32-S3R8) ──────────────────
CONFIG_IDF_TARGET="esp32s3"
CONFIG_APP_REPRODUCIBLE_BUILD=y

# 8 MB flash. Default flash mode (DIO) and freq are left untouched — they are
# universally safe on the XIAO's module; bump to QIO/80MHz only if you verify
# boot on your unit.
CONFIG_ESPTOOLPY_FLASHSIZE_8MB=y
CONFIG_PARTITION_TABLE_SINGLE_APP_LARGE=y

# The XIAO ESP32-S3 carries 8 MB of OCTAL PSRAM. It is left DISABLED here: this
# firmware's working set is a few hundred bytes and enabling SPIRAM only grows
# the image. If you ever need it, uncomment the block below (octal mode is
# mandatory for this module — the wrong mode will hang at boot):
# CONFIG_SPIRAM=y
# CONFIG_SPIRAM_MODE_OCT=y
# CONFIG_SPIRAM_SPEED_80M=y

# ── BLE: NimBLE host, broadcaster-only ───────────────────────────────────────
CONFIG_BT_ENABLED=y
CONFIG_BT_NIMBLE_ENABLED=y

# Roles: keep only the broadcaster (advertising). Drop central, observer, and
# peripheral — a non-connectable beacon needs none of them. GATT server/client
# and the GAP service fall away with the peripheral role.
CONFIG_BT_NIMBLE_ROLE_BROADCASTER=y
CONFIG_BT_NIMBLE_ROLE_CENTRAL=n
CONFIG_BT_NIMBLE_ROLE_OBSERVER=n
CONFIG_BT_NIMBLE_ROLE_PERIPHERAL=n
CONFIG_BT_NIMBLE_GATT_SERVER=n
CONFIG_BT_NIMBLE_GATT_CLIENT=n
CONFIG_BT_NIMBLE_GAP_SERVICE=n

# Security / pairing / bonding: none of it applies to a broadcast tag. We rotate
# our own keys, so NimBLE's host-based privacy (RPA) is off too. Disabling SM
# here is what lets the SMP layer's mbedTLS crypto (AES/CMAC/ECDH) get garbage-
# collected out of the image.
CONFIG_BT_NIMBLE_SECURITY_ENABLE=n
CONFIG_BT_NIMBLE_SM_LEGACY=n
CONFIG_BT_NIMBLE_SM_SC=n
CONFIG_BT_NIMBLE_LL_CFG_FEAT_LE_ENCRYPTION=n
CONFIG_BT_NIMBLE_HS_PVCY=n
CONFIG_BT_NIMBLE_MAX_CONNECTIONS=0

# Legacy advertising only. Apple Find My / OpenHaystack beacons use legacy adv,
# so the BT 5.0 extended/2M/coded-PHY machinery is dead weight here.
CONFIG_BT_NIMBLE_50_FEATURE_SUPPORT=n
CONFIG_BT_NIMBLE_LL_CFG_FEAT_LE_2M_PHY=n
CONFIG_BT_NIMBLE_LL_CFG_FEAT_LE_CODED_PHY=n

# Keep NimBLE's crypto routed through mbedTLS even with security disabled.
# Otherwise NimBLE falls back to its bundled TinyCrypt, whose ecc.c exports the
# same uECC_* symbol names as the vendored micro-ecc component and the link
# fails with "multiple definition of uECC_*". (Depends only on BT_NIMBLE_ENABLED.)
CONFIG_BT_NIMBLE_CRYPTO_STACK_MBEDTLS=y

# Test/debug surface
CONFIG_BT_NIMBLE_DTM_MODE_TEST=n
CONFIG_BT_NIMBLE_LOG_LEVEL_NONE=y

# ── BLE controller (precompiled blob — these mostly free internal RAM) ───────
CONFIG_BT_CTRL_BLE_ADV=y
CONFIG_BT_CTRL_BLE_SCAN=n
CONFIG_BT_CTRL_BLE_MASTER=n
CONFIG_BT_CTRL_BLE_SECURITY_ENABLE=n
CONFIG_BT_CTRL_DTM_ENABLE=n
CONFIG_BT_CTRL_LE_PING_EN=n
CONFIG_BT_CTRL_BLE_SCAN_DUPL=n
CONFIG_BT_CTRL_BLE_MAX_ACT=1

# ── mbedTLS: keep only what crypto.c uses (SHA-256 + bignum/MPI) ──────────────
# NOTE: these cuts mainly save BUILD TIME and guarantee unused code stays out;
# they reclaim ~0 flash on their own, because gc-sections already drops anything
# unreferenced. We do NOT touch AES/CMAC/ECDH/ECP primitives — if referenced by
# NimBLE's SMP they must stay, and if not, gc already removes them.
CONFIG_MBEDTLS_TLS_ENABLED=n
CONFIG_MBEDTLS_CERTIFICATE_BUNDLE=n
CONFIG_MBEDTLS_ERROR_STRINGS=n
CONFIG_MBEDTLS_SELF_TEST=n
CONFIG_MBEDTLS_FS_IO=n
CONFIG_MBEDTLS_HAVE_TIME=n

# ── Logging ──────────────────────────────────────────────────────────────────
# Default every tag to WARN-and-above to keep the noisy IDF/NimBLE/controller
# components quiet. The maximum level is raised to VERBOSE so that our own tags
# (main, ble_adv, crypto, tag, nvs_store) can be opened up to full verbosity at
# runtime via esp_log_level_set() in app_main — without VERBOSE compiled in,
# those calls could not raise past the default.
CONFIG_LOG_DEFAULT_LEVEL_WARN=y
CONFIG_LOG_MAXIMUM_LEVEL_VERBOSE=y

# The 2nd-stage bootloader runs before app_main and is governed by its own
# compile-time level (not esp_log_level_set), so quiet it to WARN as well.
CONFIG_BOOTLOADER_LOG_LEVEL_WARN=y
```
